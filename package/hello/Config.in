## package/jailhouse/Config.in
```kconfig
config BR2_PACKAGE_JAILHOUSE
	bool "jailhouse"
	help
	  Linux-based partitioning hypervisor

	  https://github.com/siemens/jailhouse
```

## package/local/Config.in
```kconfig
config BR2_PACKAGE_LOCAL
	bool "local"
	help
	  A simple package to be used with LOCAL_OVERRIDE_SRCDIR
```
